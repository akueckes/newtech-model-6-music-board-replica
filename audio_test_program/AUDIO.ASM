;	AUDIO TEST UTILITY V1.0
;
;	TEST S100 BASED AUDIO BOARDS - CURRENTLY SUPPORTED:
;
;       - CROMEMCO D+7A (INCLUDING JS-1 JOYSTICK)
;	- ADS NOISEMAKER (WITH AY-3-8910 PSG CHIP)
;	- NEWTECH MODEL 6 MUISC BOARD
;	- SOLID STATE MUSIC SB-1
;
;	(C) COPYRIGHT 2026 ANSGAR KUECKES
;
;	TEMPI		METRONOME
;
;	LARGO:		40-60 BPM
;	LARGHETTO:	60-66 BPM
;	ADAGIO:		66-76 BPM
;	ANDANTE:	76-108 BPM
;	MODERATO:	108-120 BPM
;	ALLEGRO:	120-168 BPM
;	PRESTO:		168-200 BPM
;	PRESTISSIMO:	>200 BPM
;
;	DYNAMICS
;
;	0: SILENCE
;	1: PIANISSISSIMO (PPP)
;	2: PIANISSIMO (PP)
;	3: PIANO (P)
;	4: MEZZO PIANO (MP)
;	5: MEZZO FORTE (MF)
;	6: FORTE (F)
;	7: FORTISSIMO (FF)
;	8: FORTISSIMISSIMO (FFF)
;
;
	ORG	100H
BDOS	EQU	0005H		;BDOS ENTRY POINT
CONS	EQU	1		;READ CONSOLE
TYPEF	EQU	2		;TYPE FUNCTION
DIO	EQU	6		;DIRECT CONSOLE I/O
PRINTF	EQU	9		;BUFFER PRINT ENTRY
READSTR	EQU	10		;BUFFERED CONSOLE INPUT
BRKF	EQU	11		;BREAK KEY FUNCTION (TRUE IF CHAR READY)
OPENF	EQU	15		;FILE OPEN
CLOSEF	EQU	16		;FILE OPEN
READF	EQU	20		;READ FUNCTION
WRITEF	EQU	21		;READ FUNCTION
MAKEF	EQU	22		;FILE CREATE
SIZEF	EQU	35		;FILE SIZE
;
FCB	EQU	5CH		;FILE CONTROL BLOCK ADDRESS
BUFF	EQU	80H		;INPUT DISK BUFFER ADDRESS
;
;    --- FILE CONTROL BLOCK DEFINITIONS ---
FCBDN	EQU	FCB+0		;DISK NAME
FCBFN	EQU	FCB+1		;FILE NAME
FCBFT	EQU	FCB+9		;DISK FILE TYPE (3 CHARACTERS)
FCBRL	EQU	FCB+12		;FILE'S CURRENT REEL NUMBER
FCBRC	EQU	FCB+15		;FILE'S RECORD COUNT (0 TO 128)
FCBCR	EQU	FCB+32		;CURRENT (NEXT) RECORD NUMBER (0 TO 127)
FCBRN	EQU	FCB+33		;FCB LENGTH
;
;    --- I/O DEFAULTS ---
DAZBAS	EQU	00EH		;DAZZLER I/O BASE ADDRESS
D7ABAS	EQU	018H		;D7A I/O BASE ADDRESS
MB1BAS	EQU	024H		;MUSIC BOARD 1 I/O BASE ADDRESS
MB2BAS	EQU	028H		;MUSIC BOARD 2 I/O BASE ADDRESS
NMBAS	EQU	0CCH		;NOISEMAKER I/O BASE ADDRESS
SB1BAS	EQU	0D3H		;SB-1 BOARD 1 MEMORY BASE ADDRESS (MSB) - DEFAULT=80H
SB2BAS	EQU	0D4H		;SB-1 BOARD 2 MEMORY BASE ADDRESS (MSB) - DEFAULT=81H
;
DAZFLG	EQU	DAZBAS
D7ACH1	EQU	D7ABAS+1
D7ACH2	EQU	D7ABAS+3
MBCH1	EQU	MB1BAS
MBCH2	EQU	MB2BAS
NM1REG	EQU	NMBAS
NM1DAT	EQU	NMBAS+1
NM2REG	EQU	NMBAS+2
NM2DAT	EQU	NMBAS+3
;
;    --- SPECIAL CHARACTERS ---
CR	EQU	0DH	;CARRIAGE RETURN
LF	EQU	0AH	;LINE FEED
;
;    --- SET UP STACK ---
	LXI	H,0
	DAD	SP
;	ENTRY STACK POINTER IN HL FROM THE CCP
	SHLD	OLDSP
;	SET SP TO LOCAL STACK AREA (RESTORED AT QUIT)
	LXI	SP,STKTOP
;	
;    --- STARTUP MESSAGE ---
	LXI	D,SIGNON
	MVI	C,PRINTF
	CALL	BDOS
	
;    --- DEFAULTS ---
	MVI	A,0		;CLEAR LEGATO FLAGS
	STA	LEGATO
	MVI	A,074H		;SET ~20 MS REST DURATION FOR ACCENT
	STA	ACCENT
	MVI	A,1		;DA+7 VS NOISEMAKER VS MUSIC BOARD VS SB-1
	STA	HARDW
	MVI	A,2
	STA	NPLAYR		;SET 2 PLAYERS/VOICES
	MVI	A,120
	STA	METRO		;USE 120 BEATS PER MINUTE
	MVI	A,1
	STA	NGEN		;ENABLE NOISE GENERATOR
	MVI	A,127
	STA	PITCHN		;USE HIGHEST PITCH AS DEFAULT FOR NOISE GENERATOR
	JMP	USRCLK		;SKIP AUTODETECT
;
;	;TRY TO DETERMINE CPU CLOCK VIA DAZZLER
	CALL	DETECT		;AUTODETECT
	JC	USRCLK
	LXI	D,FNDMSG	;OUTPUT RESULT
	MVI	C,PRINTF
	CALL	BDOS
	LDA	SYSCLK
	CALL	PNIB
	LXI	D,MHZMSG
	MVI	C,PRINTF
	CALL	BDOS
	JMP	TABLES
;
	;ASK USER FOR CPU CLOCK
USRCLK:	MVI	A,0
	STA	DAZZLR
	LXI	D,CLKMSG
	MVI	C,PRINTF
	CALL	BDOS
	MVI	A,8		;INPUT SYSTEM CLOCK
	CALL	CINPUT
	CPI	0
	JZ	USRCLK		;REPEAT FOR ZERO INPUT
	MVI	B,1
	CALL	GETNUM
	MOV	A,L
	STA	SYSCLK
;
;    --- SETUP TABLES ---
TABLES:	CALL	MKWAVT		;COPY SINUS WAVEFORM INTO WAVE TABLE
	LXI	H,WAVET		;FILL WAVEFORM #15 WITH RANDOM NOISE
	MVI	A,15
	ADD	H
	MOV	H,A
	MVI	A,1
	STA	SEED
TAB2:	CALL	RND
	MOV	M,A
	INR	L
	JNZ	TAB2
;
	;INITIALIZE VOLUME & CURRENT WAVEFORMS FOR LEFT AND RIGHT CHANNELS
	MVI	A,7		;VOLUME 0-7
	STA	VOL1
	STA	VOL2
	DCR	A
	STA	WFORMA		;SELECT CHANNEL 1 VOLUME VIA WAVETABLE
	STA	WFORMB		;SELECT CHANNEL 2 VOLUME VIA WAVETABLE
	CALL	SPITCH		;SETUP PITCH TABLE
	CALL	SMETRO		;SETUP METRONOME TABLE
;
;    --- MAIN MENU ---
	CALL	CRLF
	CALL	PRHW
MENU:	; PRINT THE MENUE
	LXI	D,USAGE1
	MVI	C,PRINTF
	CALL	BDOS
	LXI	D,USAGE2
	MVI	C,PRINTF
	CALL	BDOS
	LXI	D,USAGE3
	MVI	C,PRINTF
	CALL	BDOS
	LXI	D,USAGE4
	MVI	C,PRINTF
	CALL	BDOS
PROMPT:	CALL	CRLF
	MVI	A,'-'		;OUTPUT PROMPT
	CALL	PCHAR
	MVI	A,' '
	CALL	PCHAR
	MVI	C,CONS		;ENTER USER INPUT
	CALL	BDOS
	ANI	0DFH		;NORMALIZE TO UPPERCASE
	CPI	'H'
	JNZ	MENU1
	JMP	SELHW		;SELECT HARDWARE
MENU1:	CPI	'T'
	JNZ	MENU2
	JMP	PLAYT		;PLAY A TONE
MENU2:	CPI	'N'
	JNZ	MENU3
	JMP	PLAYN		;PLAY NOISE
MENU3:	CPI	'F'
	JNZ	MENU4
	JMP	PSMPLF		;PLAY SAMPLE FILE
MENU4:	CPI	'S'
	JNZ	MENU5
	JMP	PSCORF		;PLAY SCORE FILE
MENU5:	CPI	'W'
	JNZ	MENU6
	JMP	WAVTBL		;LOAD WAVETABLE FILE
MENU6:	CPI	'A'
	JNZ	MENU7
	JMP	TEST		;RUN AUDIO TEST
MENU7:	CPI	'J'
	JNZ	MENU8
	JMP	JOYSTK		;RUN JOYSTICK TEST
MENU8:	CPI	'Q'
	JNZ	MENU
QUIT:	;QUIT PROGRAM
	MVI	A,0		;DISABLE DAZZLER (IF NOT ALREADY DONE)
	OUT	0EH
	LHLD	OLDSP		;RESTORE CCP STACK POINTER
	SPHL
	RET			;RETURN TO CCP
;
;    --- MENUE FUNCTIONS ---
;
SELHW:	;SELECT HARDWARE
	LXI	D,HWMSG
	MVI	C,PRINTF
	CALL	BDOS
	LXI	D,NOISEM
	MVI	C,PRINTF
	CALL	BDOS
	LXI	D,D7A
	MVI	C,PRINTF
	CALL	BDOS
	LXI	D,MB
	MVI	C,PRINTF
	CALL	BDOS
	LXI	D,SB1
	MVI	C,PRINTF
	CALL	BDOS
	MVI	A,'-'		;OUTPUT PROMPT
	CALL	PCHAR
	MVI	A,' '
	CALL	PCHAR
	MVI	C,CONS		;ENTER USER INPUT
	CALL	BDOS
	ORA	A		;CLEAR CARRY
	SBI	'0'
	STA	HARDW		;0=ADS NOISEMAKER, 1=CROMEMCO D+7A, 2=NEWTECH MUSIC BOARD 3=SSM SB-1
	CPI	3
	JNZ	SH3
	CALL	SBINIT		;INITIALIZE SB-1
	JMP	SH5
SH3:	CPI	0
	JNZ	SH4
	CALL	NINIT		;INITIALIZE NOISEMAKER
	JMP	SH5
SH4:	CALL    INIT		;INITIALIZE CROMEMCO D+7A / NEWTECH MUSIC MAKER
SH5:	CALL	SPITCH		;UPDATE PITCH TABLE
	CALL	SMETRO		;UPDATE METRONOME TABLE
	CALL	MKWAVT		;RE-CREATE WAVETABLE
	CALL	PRHW		;PRINT NEW HARDWARE SETTING
	JMP	PROMPT
;
PLAYT:	;PLAY TONE WITH VOLUME, DURATION & PITCH
	CALL	GETVOL		;PROMPT FOR VOLUME
	JC	PROMPT
	CALL	GETDUR		;PROMPT FOR DURATION
	JC	PROMPT
PT0:	LXI	D,PITMSG	;PROMPT FOR 16-BIT PITCH
	LDA	HARDW
	CPI	0
	JNZ	PT1
	LXI	D,PI2MSG	;PROMPT FOR 12-BIT PITCH
PT1:	MVI	C,PRINTF
	CALL	BDOS
	MVI	A,8		;INPUT PITCH
	CALL	CINPUT
	CPI	0
	JZ	PROMPT
	MVI	B,3		;UP TO 3 DIGITS FOR NOISEMAKER
	LDA	HARDW
	CPI	0
	JZ	PT2
	MVI	B,4		;UP TO 4 DIGITS FOR ALL OTHERS
PT2:	CALL	GETNUM
	JC	PROMPT
	MOV	A,L
	STA	PITCHA
	STA	PITCHB
	MOV	A,H
	STA	PITCHA+1
	STA	PITCHB+1
	CALL	PTONE
	JMP	PT0
;
PLAYN:	;PLAY NOISE
	LDA	HARDW
	CPI	3		;SB-1 LACKS NOISE GENERATOR
	JNZ	PLN0
	LXI	D,NONOIS
	MVI	C,PRINTF
	CALL	BDOS
	JMP	PROMPT	
PLN0:	CALL	GETVOL		;PROMPT FOR VOLUME
	JC	PROMPT
	CALL	GETDUR		;PROMPT FOR DURATION
	JC	PROMPT
PLN1:	LXI	D,PINMSG	;PROMPT FOR PITCH
	MVI	C,PRINTF
	CALL	BDOS
	MVI	A,8		;INPUT NOISE PITCH (0=LOWEST, FF=HIGHEST)
	CALL	CINPUT
	CPI	0
	JZ	PROMPT
	MVI	B,2		;UP TO 2 DIGITS
	CALL	GETNUM
	JC	PROMPT
	MOV	A,L
	ANI	07FH
	STA	PITCHN
	CALL	PNOISE
	JMP	PLN1
;
PSMPLF:	;PLAY STEREO 8-BIT SAMPLES FROM FILE (2 SIGNED BYTES/16 BITS PER STEREO SAMPLE)
	CALL	FOPEN
	JNC	PROMPT		;QUIT ON ERROR
	CALL	CRLF
	LXI	D,FCB		;GET FILE SIZE
	MVI	C,SIZEF
	CALL	BDOS
	LXI	H,STKTOP	;READ THE FILE INTO MEMORY
	CALL	FREAD
	JNC	PROMPT		;QUIT ON ERROR
	CALL	FCLOSE		;CLOSE FILE
	LXI	D,SPDMSG	;PROMPT FOR SPEED
	MVI	C,PRINTF
	CALL	BDOS
	MVI	A,8		;INPUT SPEED
	CALL	CINPUT
	CPI	0
	JZ	PROMPT
	MVI	B,2		;UP TO 2 DIGITS
	CALL	GETNUM
	MOV	H,L		;STORE SPEED IN H
	ORA	A		;STORE SAMPLE COUNT IN B/C
	LDA	FCBRC		;NUMBER OF 128 BYTE RECORDS
	RAR
	MOV	B,A
	MVI	A,0
	RAR
	MOV	C,A
	LXI	D,STKTOP	;STORE ADDRESS OF SAMPLES IN D/E
	CALL	PSAMPL		;PLAY SAMPLES
	JMP	PROMPT
;
PSCORF:	;PLAY SCORE FROM FILE
	CALL	FOPEN
	JNC	PROMPT		;QUIT ON ERROR
	CALL	CRLF
	LXI	H,STKTOP	;READ THE FILE INTO MEMORY
	CALL	FREAD
	JNC	PROMPT		;QUIT ON ERROR
	CALL	FCLOSE		;CLOSE FILE
	LXI	D,STKTOP
	CALL	PSCORE
	JMP	PROMPT
;
WAVTBL:	;LOAD WAVE TABLE FROM FILE
	CALL	FOPEN		;LOAD MASTER
	JNC	PROMPT		;QUIT ON ERROR
	CALL	CRLF
	LXI	H,SIN256	;READ THE FILE INTO WAVETABLE MASTER
	CALL	FREAD
	JNC	PROMPT		;QUIT ON ERROR
	CALL	FCLOSE		;CLOSE FILE
	CALL	MKWAVT		;RE-CREATE WAVE TABLE 
	JMP	PROMPT
;
TEST:	;RUN AUDIO TEST
	;PART I: SLIDING TONES (LEFT/RIGHT TEST)
	LXI	D,TMSG1
	MVI	C,PRINTF
	CALL	BDOS
	MVI	A,4		;HALF VOLUME
	STA	VOL1
	STA	VOL2
	MVI	A,2		;DURATION
	STA	DURAT+1
	MVI	A,0
	STA	DURAT
	STA	PITCHA
	STA	PITCHA+1
	STA	PITCHB
	LDA	HARDW
	CPI	0		;NOISEMAKER?
	JZ	TST11
	CPI	3		;SB-1?
	JZ	TST11
	JMP	TST0
TST11:	MVI	A,8		;NOISEMAKER OR SB-1
	STA	PITCHB+1
	MVI	A,0
TST6:	PUSH	A		;LOOP COUNTER
	LDA	PITCHA
	ADI	02H
	STA	PITCHA
	LDA	PITCHA+1
	ACI	0
	STA	PITCHA+1
	LDA	PITCHB
	SUI	02H
	STA	PITCHB
	LDA	PITCHB+1
	SBI	0
	STA	PITCHB+1
	CALL	PTONE
	POP	A
	INR	A
	JP	TST6
	JMP	TST7
TST0:	PUSH	A		;ALL OTHERS
	STA	PITCHA+1
	MOV	B,A
	MVI	A,127
	SUB	B
	STA	PITCHB+1
	CALL	PTONE
	POP	A
	INR	A
	JP	TST0
; PART II: STEREO POSITIONING TEST
TST7:	LXI	D,TMSG2
	MVI	C,PRINTF
	CALL	BDOS
	MVI	A,16		;DURATION
	STA	DURAT+1
	LDA	HARDW
	CPI	0
	JNZ	TST8
	MVI	A,2		;NOISEMAKER PITCH MSB
	JMP	TST9
TST8:	CPI	3
	JNZ	TST12
	MVI	A,4		;SB-1 OCTAVE
	JMP	TST9
TST12:	MVI	A,8		;DAC PITCH
TST9:	STA	PITCHA+1
	STA	PITCHB+1
	MVI	A,0
	STA	PITCHA
	STA	PITCHB
	MVI	A,1		;START VOLUME
	MVI	B,1		;START DIRECTION
TST1:	PUSH	A
	PUSH	B
	STA	VOL1
	DCR	A
	STA	WFORMA
	MOV	B,A
	MVI	A,7
	SUB	B
	STA	VOL2
	DCR	A
	STA	WFORMB
	CALL	PTONE
	POP	B
	POP	A
	ADD	B
	CPI	0
	JZ	TST2
	CPI	7
	JC	TST1
	MVI	B,-1		;TURN BACK
	JMP	TST1
; PART III: WHITE NOISE TEST
TST2:	LDA	HARDW
	CPI	3		;SB-1 LACKS NOISE GENERATOR
	JZ	TST10
	LXI	D,TMSG3
	MVI	C,PRINTF
	CALL	BDOS
	MVI	A,16		;DURATION
	STA	DURAT+1
	MVI	A,07FH
	STA	PITCHN
	MVI	A,1		;START VOLUME
	MVI	B,1		;DIRECTION
TST3:	PUSH	A		;TEST NOISE VOLUME
	PUSH	B
	STA	VOL1
	STA	VOL2
	CALL	PNOISE
	POP	B
	POP	A
	ADD	B
	CPI	0
	JZ	TST4
	CPI	7
	JC	TST3
	MVI	B,-1		;TURN BACK
	JMP	TST3
TST4:	MVI	A,4		;TEST NOISE PITCH
	STA	VOL1
	STA	VOL2
	LXI	H,500
	SHLD	DURAT		;DURATION
	MVI	A,07FH
TST5:	STA	PITCHN
	CALL	PNOISE
	LDA	PITCHN
	DCR	A
	JNZ	TST5
	MVI	A,1
; PART VI: PLAY SCORE
TST10:	LXI	D,TMSG4
	MVI	C,PRINTF
	CALL	BDOS
	LXI	D,SCORE		;POINTER TO SCORE TABLE
	CALL	PSCORE
	JMP	PROMPT
;
JOYSTK:	; JOYSTICK / GAME CONTROLLER TEST
	CALL	BREAK
	RRC
	JC	PROMPT
	IN	24		;BUTTONS JOYSTICKS 1 & 2
	CALL	PHEX
	MVI	A,','
	CALL	PCHAR
	IN	25		;X-AXIS JOYSTICK 1
	CALL	PHEX
	MVI	A,','
	CALL	PCHAR
	IN	26		;Y-AXIS JOYSTICK 1
	CALL	PHEX
	MVI	A,','
	CALL	PCHAR
	IN	27		;X-AXIS JOYSTICK 2
	CALL	PHEX
	MVI	A,','
	CALL	PCHAR
	IN	28		;Y-AXIS JOYSTICK 2
	CALL	PHEX
	CALL	CRLF
	JMP	JOYSTK
;
PRHW:	;PRINT CURRENT HARDWARE
	LDA	HARDW
	CPI	0
	JNZ	PRHW1
	LXI	D,NMKMSG	;NOISEMAKER
	MVI	C,PRINTF
	CALL	BDOS
	MVI	A,NMBAS
	CALL	PHEX
	MVI	A,'H'
	CALL	PCHAR
	CALL	CRLF
	RET
PRHW1:	CPI	1
	JNZ	PRHW2
	LXI	D,D7AMSG	;D+7A
	MVI	C,PRINTF
	CALL	BDOS
	MVI	A,D7ABAS
	CALL	PHEX
	MVI	A,'H'
	CALL	PCHAR
	CALL	CRLF
	RET
PRHW2:	CPI	2
	JNZ	PRHW3
	LXI	D,MBMSG
	MVI	C,PRINTF	;MUSIC BOARD
	CALL	BDOS
	MVI	A,MB1BAS
	CALL	PHEX
	MVI	A,'H'
	CALL	PCHAR
	MVI	A,'+'
	CALL	PCHAR
	MVI	A,MB2BAS
	CALL	PHEX
	MVI	A,'H'
	CALL	PCHAR
	CALL	CRLF
	RET
PRHW3:	CPI	3
	RNZ
	LXI	D,SB1MSG
	MVI	C,PRINTF	;SB-1
	CALL	BDOS
	MVI	A,SB1BAS
	CALL	PHEX
	MVI	A,0
	CALL	PHEX	
	MVI	A,'H'
	CALL	PCHAR
	MVI	A,'+'
	CALL	PCHAR
	MVI	A,SB2BAS
	CALL	PHEX
	MVI	A,0
	CALL	PHEX	
	MVI	A,'H'
	CALL	PCHAR
	CALL	CRLF
	RET
;
GETVOL:	LXI	D,VOLMSG	;PROMPT FOR VOLUME
	MVI	C,PRINTF
	CALL	BDOS
	MVI	A,8		;INPUT VOLUME
	CALL	CINPUT
	CPI	0		;TERMINATE ON SILENCE
	STC
	RZ
	MVI	B,1		;UP TO 1 DIGIT
	CALL	GETNUM
	RC
	MOV	A,L
	STA	VOL1
	STA	VOL2
	DCR	A
	STA	WFORMA		;ADJUST WAVETABLE BY VOLUME
	STA	WFORMB
	RET
;
GETDUR:	LXI	D,DURMSG	;PROMPT FOR DURATION
	MVI	C,PRINTF
	CALL	BDOS
	MVI	A,8		;INPUT DURATION
	CALL	CINPUT
	CPI	0
	STC
	RZ
	MVI	B,2		;UP TO 2 DIGITS
	CALL	GETNUM
	RC
	MVI	A,0
	STA	DURAT
	MOV	A,L
	STA	DURAT+1
	RET
;
;
;    --- HARDWARE INDEPENDENT AUDIO ROUTINES ---
;
;	PSCORE - PLAY SCORE FROM SCORE TABLE WITH ADDRESS IN D/E
;
;	SCORE TABLE - ACTUAL MUSIC SCORE (THREE BYTES PER EVENT)
;
;	RESTRICTIONS:
;	- 2 CHANNELS WITH ONE VOICE PER CHANNEL
;	- 7 VOLUME LEVELS PLUS SILENCE (VOLUMES IMPLEMENTED WITH WAVEFORMS FOR BETTER PERFORMANCE)
;	- NO ENVELOPES YET (NOISEMAKER & SB-1 ARE ALWAYS USING FLAT ENVELOPES)
;	- NO CONCURRENT PLAYBACK OF MUSIC + WHITE NOISE
;
PSCORE:	LDAX	D		;GET 1ST BYTE FROM SCORE TABLE (COMMAND + PARAMETER)
	ANI	0FH		;GET PARAMETER INTO B
	MOV	B,A
	LDAX	D		;GET COMMAND
	RRC
	RRC
	RRC
	RRC
	ANI	07H
	CPI	0		;TERMINATE COMMAND
	JNZ	PS15
	LDA	HARDW
	CPI	0
	RNZ			;NO ACTION FOR DAC'S
	MVI	A,7		;DISABLE LEFT CHANNEL
	OUT	NM1REG
	MVI	A,0FFH
	OUT	NM1DAT
	MVI	A,7		;DISABLE RIGHT CHANNEL
	OUT	NM2REG
	MVI	A,0FFH
	OUT	NM2DAT	
	RET
PS15:	CPI	1		;MUSIC/NOISE EVENT
	JZ	EVENT	
	CPI	2		;VOLUME COMMAND
	JNZ	PS9
	MOV	A,B
	CPI	8		;WE SUPPORT ONLY 7 LEVELS PLUS SILENCE
	JC	PS11
	MVI	A,7		;MAX VOLUME
PS11:	STA	VOL1		;TODO: VOLUME FOR EACH VOICE
	STA	VOL2
	DCR	A		;WAVETABLE INDEX = VOLUME-1
	MOV	B,A
	JMP	PS12
PS9:	CPI	3		;WAVEFORM COMMAND?
	JNZ	PS4
PS12:	LDAX	D
	ANI	080H		;APPLY TO ALL VOICES?
	JZ	PS7
	INX	D		;GET VOICE SELECTION FROM COMPLEMENTARY BYTE
	LDAX	D
	CPI	0
	JNZ	PS6
	MOV	A,B		;VOICE 0 / CHANNEL A
	STA	WFORMA
	JMP	PSDONE
PS6:	MOV	A,B		;VOICE 1 / CHANNEL B
	STA	WFORMB
	JMP	PSDONE
PS7:	MOV	A,B		;APPLY TO ALL VOICES/CHANNELS
	STA	WFORMA
	STA	WFORMB
	JMP	PSDONE
PS4:	CPI	4		;ENVELOPE COMMAND (NOT YET IMPLEMENTED)
	JNZ	PS5
	MOV	A,B
	STA	ENVEL
	JMP	PSDONE
PS5:	CPI	5		;NUMBER VOICES COMMAND (NOT YET IMPLEMENTED)
	JNZ	PS10
	MOV	A,B
	STA	NPLAYR
	JMP	PSDONE
PS10:	CPI	6		;METRONOME/TEMPO COMMAND
	JNZ	PS17
	INX	D
	LDAX	D
	STA	METRO
	PUSH	D
	CALL	SMETRO		;SET METRONOME
	POP	D
	JMP	PSDONE
PS17:	CPI	7		;MODE COMMAND (CURRENTLY ONLY TONE VS. NOISE SUPPORTED) 
	JNZ	PSDONE
	LDAX	D
	ANI	080H		;APPLY TO ALL VOICES?
	JZ	PS22
	INX	D		;WHICH CHANNEL?
	LDAX	D
	INR	A
	MOV	C,A		;CREATE BIT MASK FOR CHANNEL
	MVI	A,0
	STC
PS19:	RAL
	DCR	C
	JNZ	PS19
	MOV	C,A		;SAVE MASK IN C
	MOV	A,B		;NOISE BIT CLEAR OR SET?
	ANI	1
	CPI	0
	JZ	PS20
	LDA	NMODE
	ORA	C		;SET NMODE BIT
	JMP	PS21
PS20:	MOV	A,C
	CMA
	MOV	C,A
	LDA	NMODE
	ANA	C
	JMP	PS21
PS22:	MOV	A,B		;SET/CLEAR ALL CHANNELS
	ANI	1
	MVI	A,0FFH
	JNZ	PS21
	MVI	A,0
PS21:	STA	NMODE
PSDONE:	INX	D		;COMMAND DONE
	JMP	PSCORE	
EVENT:	LXI	H,DURATT	;POINTER TO DURATION TABLE
	MOV	A,B
	RLC
	MOV	L,A
	MOV	A,M
	STA	DURAT		;UPDATE 16-BIT DURATION COUNTER
	INR	L
	MOV	A,M
	STA	DURAT+1
	MVI	A,0		;RESET LEGATO
	STA	LEGATO
	LDA	NMODE		;TEST FOR NOISE (TODO: INDIVIDUAL TEST PER VOICE)
	ANI	3
	JNZ	PSNOIS
PSTONE:	;PLAY TONE
	LDA	VOL1		;SELECT WAVFORM ACCORDING TO VOLUME
	DCR	A
	STA	WFORMA
	LDA	VOL2
	DCR	A
	STA	WFORMB
	INX	D		;GET 2ND BYTE FROM SCORE TABLE (LEGATOFLAG + VOICE 0)
	LDAX	D
	ORA	A		;CLEAR CARRY
	RAL			;TIMES 2, LEGATO FLAG IN CARRY
	LXI	H,PITCHT
	MOV	L,A
	MOV	A,M
	STA	PITCHA		;STORE 16-BIT PITCH FOR VOICE 0
	INR	L
	MOV	A,M
	STA	PITCHA+1
	JNC	PS13
	LDA	LEGATO		;SET LEGATO FLAG FOR VOICE 0
	ORI	1
	STA	LEGATO
PS13:	INX	D		;GET 3RD BYTE FROM SCORE TABLE (LEGATOFLAG + VOICE 1)
	LDAX	D
	ORA	A		;CLEAR CARRY
	RAL			;TIMES 2, LEGATO FLAG IN CARRY
	LXI	H,PITCHT
	MOV	L,A
	MOV	A,M
	STA	PITCHB		;STORE 16-BIT PITCH FOR VOICE 1
	INR	L
	MOV	A,M
	STA	PITCHB+1
	JNC	PS14
	LDA	LEGATO		;SET LEGATO FLAG FOR VOICE 1
	ORI	2
	STA	LEGATO
PS14:	PUSH	D
	CALL	PTONE		;PLAY TONE WITH ACCURATE PITCH OR REST
;	CALL	BREAK		;CHECK FOR KEY
;	RRC
;	JNC	PS3		;RETURN IF KEY PRESS
;	POP	D
;	RET
PS3:	JMP	PACCNT
PSNOIS:	;USE WHITE NOISE GENERATOR
	INX	D		;GET 2ND BYTE (PITCH + LEGATO VOICE 0)
	LDAX	D
	ANI	080H
	JZ	PS16
	LDA	LEGATO
	ORI	1
	STA	LEGATO
PS16:	LDAX	D
	ANI	07FH
	MOV	B,A
	INX	D		;GET 3RD BYTE (PITCH + LEGATO VOICE 1)
	PUSH	D		;SAVE SCORE INDEX
	LDAX	D
	ANI	080H
	JZ	PS18
	LDA	LEGATO
	ORI	1
	STA	LEGATO
PS18:	LDAX	D
	ANI	07FH	
	ORA	B		;TODO: SEPARATE NOISE VOICES
	STA	PITCHN
	CALL	PNOISE
PACCNT:	;PLAY ACCENT IF APPLICABLE
	LDA	LEGATO
	ANI	2		;CHECK LEGATO FLAG VOICE 1
	JNZ	PS1
	STA	PITCHB		;SET PITCH 0 FOR ACCENT (SHORT REST)
	STA	PITCHB+1
PS1:	LDA	LEGATO
	ANI	1		;CHECK LEGATO FLAG VOICE 0
	JNZ	PS2
	STA	PITCHA		;SET PITCH 0 FOR ACCENT (SHORT REST)
	STA	PITCHA+1
PS2:	LDA	ACCENT		;VERY SHORT DURATION FOR ACCENT
	STA	DURAT
	XRA	A
	STA	DURAT+1
	CALL	PTONE		;PLAY ACCENT (REST)
	POP	D
	INX	D
	JMP	PSCORE		;CONTINUE WITH NEXT NOTE
;
;
;	PTONE - WRAPPER FOR PLAYING A TONE ON THE CURRENT HARDWARE
;
;	16-BIT PITCH IN PITCHA AND PITCHB (HARDWARE DEPENDENT)
;	16-BIT DURATION IN DURAT (HARDWARE DEPENDENT)
;	4-BIT VOLUME IN VOLUME
;	2-BIT FLAGS FOR TIEING TOGETHER WITH THE NEXT NOTE IN LEGATO (BIT X FOR CHANNEL X)
;
PTONE:	LDA	HARDW		;CHECK HARDWARE
	CPI	0
	JZ	PTONEN		;PLAY TONE WITH NOISEMAKER
	CPI	3
	JZ	PTONES		;PLAY TONE WITH SB-1
	JMP	PTONEA		;PLAY TONE WITH D+7A OR MUSIC BOARD (HIGH ACCURATE PITCH)
;
;
;    --- SOLID STATE MUSIC SB-1 AUDIO ROUTINES ---
;
;
;	SBINIT - INITIALIZE SSM SB-1 HARDWARE (BOTH BOARDS)
;
SBINIT:	MVI	A,0FFH		;SET ~20 MS REST DURATION FOR ACCENT
	STA	ACCENT
	MVI	H,SB1BAS	;INITIALIZE SB-1 BOARD 1
	MVI	L,0F3H		;RESET BOARD
	MVI	M,080H
	MVI	L,0F2H		;STOP BOARD
	MVI	A,080H
	MOV	M,A
	STA	SB1CTL		;SAVE INTO SHADOW REGISTER
	MVI	H,SB2BAS	;INITIALIZE SB-1 BOARD 2
	MVI	L,0F3H		;RESET BOARD
	MVI	M,080H
	MVI	L,0F2H		;STOP BOARD
	MVI	A,080H
	MOV	M,A
	STA	SB2CTL		;SAVE INTO SHADOW REGISTER
	LXI	H,SIN32		;LOAD WAVEFORM
	MVI	B,SB1BAS
	MVI	D,SB2BAS
	MVI	C,0
	MVI	E,0
SBI1:	MOV	A,M
	STAX	B
	STAX	D
	INX	H
	INR	C
	INR	E
	MOV	A,C
	CPI	020H
	JNZ	SBI1
	LXI	H,ENV16		;LOAD ENVELOPE
	MVI	B,SB1BAS
	MVI	D,SB2BAS
	MVI	C,0E0H
	MVI	E,0E0H
SBI2:	MOV	A,M
	STAX	B
	STAX	D
	INX	H
	INR	C
	INR	E
	MOV	A,C
	CPI	0F0H
	JNZ	SBI2
	RET
;
;	PTONES - PLAY A TONE ON SSM SB-1
;
;	16-BIT PITCH DENOTES OCTAVE IN MSB & FREQ IN LSB
;
;	FREQUENCY = 20,000,000 / ((256 - FREQ) * 32 * 2 ^ (8 - OCTAVE))
;       PITCH = 256 - 20,000,000 / (FREQUENCY * 32 * 2 ^ (8 - OCTAVE)) + OCTAVE * 256)
;
;	A4 = 440.0 HZ = PITCH 04A7H = 1191 DECIMAL
;
;	PITCH 0 PROGAMMATICALLY DENOTES SILENCE (REST)
;
;
PTONES:	;LEFT CHANNEL
	LDA	PITCHA		;CHECK FOR SILENCE ON CHANNEL 1
	MOV	B,A
	LDA	PITCHA+1
	ORA	B
	JZ	PTS0
	LDA	PITCHA		;SET FREQUENCY
	STA	(SB1BAS*0100H)+0F0H
	LDA	VOL1		;SET VOLUME & OCTAVE
	ANI	0FH
	RLC
	RLC
	RLC
	RLC
	MOV	B,A
	LDA	PITCHA+1
	ANI	0FH
	ORA	B
	STA	(SB1BAS*0100H)+0F1H
	LDA	SB1CTL		;ENABLE BOARD 1
	ANI	07FH
	STA	SB1CTL
	STA	(SB1BAS*0100H)+0F2H
	JMP	PTS1
PTS0:	LDA	SB1CTL		;DISABLE BOARD 1 FOR PLAYING REST (JUST IN CASE IT IS ACTIVE)
	ORI	080H
	STA	SB1CTL
	STA	(SB1BAS*0100H)+0F2H
PTS1:	;RIGHT CHANNEL
	LDA	PITCHB		;CHECK FOR SILENCE ON CHANNEL 1
	MOV	B,A
	LDA	PITCHB+1
	ORA	B
	JZ	PTS2
	LDA	PITCHB		;SET FREQUENCY
	STA	(SB2BAS*0100H)+0F0H
	LDA	VOL2		;SET VOLUME & OCTAVE
	ANI	0FH
	RLC
	RLC
	RLC
	RLC
	MOV	B,A
	LDA	PITCHB+1
	ANI	0FH
	ORA	B
	STA	(SB2BAS*0100H)+0F1H
	LDA	SB2CTL		;ENABLE BOARD 2
	ANI	07FH
	STA	SB2CTL
	STA	(SB2BAS*0100H)+0F2H
	JMP	PTS3
PTS2:	LDA	SB2CTL		;DISABLE BOARD 2 FOR PLAYING REST (JUST IN CASE IT IS ACTIVE)
	ORI	080H
	STA	SB2CTL
	STA	(SB2BAS*0100H)+0F2H
PTS3:	LHLD	DURAT		;IDLE FOR DURATION
PTS4:	MOV	A,H
	ORA	L
	JZ	PTS6
	MVI	A,20		;CALIBRATION
PTS5:	DCR	A
	JNZ	PTS5
	DCX	H
	JMP	PTS4
PTS6:	;END OF TONE
	LDA	LEGATO
	ANI	1
	JNZ	PTS7
	LDA	SB1CTL		;DISABLE LEFT CHANNEL (TONE DONE)
	ORA	080H
	STA	SB1CTL
	STA	(SB1BAS*0100H)+0F2H
PTS7:	LDA	LEGATO
	ANI	2
	RNZ
	LDA	SB2CTL		;DISABLE RIGHT CHANNEL (TONE DONE)
	ORA	080H
	STA	SB2CTL
	STA	(SB2BAS*0100H)+0F2H
	RET
;
;    --- ADS NOISEMAKER AUDIO ROUTINES ---
;
;	NMINIT - INITIALIZE NOISEMAKER HARDWARE
;
NINIT:	MVI	A,0FFH	;	SET ~50 MS REST DURATION FOR ACCENT
	STA	ACCENT
	RET
;
;	PTONEN - PLAY A TONE ON ADS NOISEMAKER / AY-3-8910
;
;	12-BIT PITCH DENOTES PERIOD LENGTH (FREQUENCY DIVIDER)
;
;	FREQUENCY = (SYSCLK * 1000000) / 16 / PITCH
;       PITCH = (SYSCLK * 1000000) / 16 / FREQUENCY
;
;	A4 = 440.0 HZ = PITCH 011CH = 284
;
;	PITCH 0 PROGAMMATICALLY DENOTES SILENCE (REST)
;
PTONEN:	;LEFT CHANNEL
	LDA	PITCHA		;CHECK FOR SILENCE ON CHANNEL 1
	MOV	B,A
	LDA	PITCHA+1
	ORA	B
	JZ	PTN1
	MVI	A,7		;SELECT ENABLE REGISTER
	OUT	NM1REG
	MVI	A,0FEH		;ENABLE TONE A
	OUT	NM1DAT
	MVI	A,8		;SELECT AMPLITUDE REGISTER
	OUT	NM1REG
	LDA	VOL1		;VOLUME
	RLC
	CPI	16
	JC	PTN0
	MVI	A,0FH		;LIMIT NOISEMAKER VOLUME TO MAX VOLUME
PTN0:	OUT	NM1DAT
	MVI	A,0		;SELECT FINE TUNE REGISTER
	OUT	NM1REG
	LDA	PITCHA
	OUT	NM1DAT
	MVI	A,1		;SELECT COARSE TUNE REGISTER
	OUT	NM1REG
	LDA	PITCHA+1
	OUT	NM1DAT
PTN1:	;RIGHT CHANNEL
	LDA	PITCHB		;CHECK FOR SILENCE ON CHANNEL 2
	MOV	B,A
	LDA	PITCHB+1
	ORA	B
	JZ	PTN3
	MVI	A,7		;SELECT ENABLE REGISTER
	OUT	NM2REG
	MVI	A,0FEH		;ENABLE TONE B
	OUT	NM2DAT
	MVI	A,8		;SELECT AMPLITUDE REGISTER
	OUT	NM2REG
	LDA	VOL2		;VOLUME
	RLC
	CPI	16
	JC	PTN2
	MVI	A,0FH		;LIMIT NOISEMAKER VOLUME TO MAX VOLUME
PTN2:	OUT	NM2DAT
	MVI	A,0		;SELECT FINE TUNE REGISTER
	OUT	NM2REG
	LDA	PITCHB
	OUT	NM2DAT
	MVI	A,1		;SELECT COARSE TUNE REGISTER
	OUT	NM2REG
	LDA	PITCHB+1
	OUT	NM2DAT
PTN3:	LHLD	DURAT		;IDLE FOR DURATION
PTN4:	MOV	A,H
	ORA	L
	JZ	PTN6
	MVI	A,20		;CALIBRATION
PTN5:	DCR	A
	JNZ	PTN5
	DCX	H
	JMP	PTN4
PTN6:	;END OF TONE
	LDA	LEGATO
	ANI	1
	JNZ	PTN7
	MVI	A,7		;MUTE LEFT CHANNEL
	OUT	NM1REG
	MVI	A,0FFH
	OUT	NM1DAT
	MVI	A,8
	OUT	NM1REG
	MVI	A,0
	OUT	NM1DAT
PTN7:	LDA	LEGATO
	ANI	2
	RNZ
	MVI	A,7		;MUTE RIGHT CHANNEL
	OUT	NM2REG
	MVI	A,0FFH
	OUT	NM2DAT
	MVI	A,8
	OUT	NM2REG
	MVI	A,0
	OUT	NM2DAT
	RET
;
;    --- CROMEMCO D+7A / NEWTECH MUSIC MAKER AUDIO ROUTINES ---
;
;	INIT - INITIALIZE CROMEMCO D+7A / NEWTECH MUSIC MAKER HARDWARE
;
INIT:	MVI	A,074H		;SET ~20 MS REST DURATION FOR ACCENT
	STA	ACCENT
	RET
;
;	PTONEF - PLAY TONE ON D+7A WITH HIGHER SAMPLE RATE, BUT LESS PITCH ACCURACY
;                8-BIT PITCH IN PITCHA+1 AND PITCHB+1
;                16-BIT DURATION IN DURAT,
;                WAVEFORMS IN WFORMA AND WFORMB
;	
;	8-BIT PITCH DENOTES FREQUENCY (PERIOD DIVIDER)
;       USES 112 CLOCK CYCLES FOR EVERY STEREO SAMPLE = 17.857 KHZ FOR 2MHZ CPU CLOCK
;
;	PITCH 0 PROGRAMMATICALLY DENOTES SILENCE (REST)
;
PTONEF:	LDA	WFORMA		;PREPARE INDEX INTO WAVETABLE
	LXI	H,WAVET
	ADD	H
	STA	WADDRA
	LDA	WFORMB
	LXI	H,WAVET
	ADD	H
	STA	WADDRB
	MVI	A,0
	MOV	C,A		;LSB LOOP COUNTER
	MOV	D,A		;WAVEFORM POINTER VOICE 0
	MOV	E,A		;WAVEFORM POINTER VOICE 1
	LDA	WADDRA
	MOV	H,A
	LDA	DURAT+1
	MOV	B,A
PTF2:	LDA	PITCHA+1	;ADD WAVE OFFSET
	ADC	D
	MOV	D,A
	MOV	L,A
	MOV	A,M		;LOAD SAMPLE FROM WAVE TABLE
	OUT	D7ACH1		;OUTPUT SAMPLE TO CHANNEL A (ADD 5.5 CLOCKS PER CHANNEL FOR WAITSTATES)
	LDA	PITCHB+1	;ADD WAVE OFFSET
	ADC	E
	MOV	E,A	
	MOV	L,A
	MOV	A,M		;LOAD SAMPLE FROM WAVE TABLE
	OUT	D7ACH2		;OUTPUT SAMPLE TO CHANNEL B (ADD 5.5 CLOCKS PER CHANNEL FOR WAITSTATES)
	DCX	B
	MOV	A,B
	ORA	C
	JNZ	PTF2
	RET
;
;	PTONEA - PLAY TONE ON D+7A AND MUSIC BOARD WITH ACCURATE PITCH, BUT LOWER SAMPLE RATE
;		 16-BIT PITCH IN PITCHA (LEFT CHANNEL) AND PITCHB (RIGHT CHANNEL)
;                16-BIT DURATION IN DURAT,
;                WAVEFORMS IN WFORMA AND WFORMB
;
;	16-BIT PITCH DENOTES FREQUENCY (PERIOD DIVIDER)
;	USES 337 CLOCK CYCLES FOR EVERY TWO STEREO SAMPLES = 11.869 KHZ SAMPLING RATE FOR
;       2MHZ CPU CLOCK OR 23.736 KHZ SAMPLING RATE FOR 4MHZ CLOCK
;
;	FREQUENCY = PITCH * (SYSCLK * 1000000) / 32768 / CLOCK_CYCLES
;	PITCH = FREQUENCY * CLOCK_CYCLES * 32768 / (SYSCLK * 1000000)
;
;	A4 = 440.0 HZ = PITCH 0ABEH = 2750 (DAZZLER DISABLED) 0947H (DAZZLER ENABLED)
;
;	PITCH 0 PRORAMMATICALLY DENOTES SILENCE (REST)
;
;	NOTE: CPU WAIT STATES AND DMA (LIKE WITH DAZZLER ENABLED) MAY RESULT IN AUDIO DISTORTIONS
;
PTONEA:	LDA	WFORMA		;PREPARE INDEX INTO WAVETABLE
	LXI	H,WAVET
	ADD	H
	STA	WADDRA
	LDA	WFORMB
	LXI	H,WAVET
	ADD	H
	STA	WADDRB
	MVI	A,0		;RESET WAVEFORM POINTERS (NOT REALLY REQUIRED)
	MOV	B,A		;INTEGER PART WAVEFORM POINTER CHANNEL A
	MOV	C,A		;FRACTION PART WAVEFORM POINTER CHANNEL A
	MOV	D,A		;INTEGER PART WAVEFORM POINTER CHANNEL B
	MOV	E,A		;FRACTION PART WAVEFORM POINTER CHANNEL B
	LHLD	DURAT		;16-BIT LOOP COUNTER
	;TWO RUNS TO FIT LOOP COUNTER INTO 16 BIT WORD
	LDA	HARDW
	CPI	1
	JNZ	PTMB		;MUSIC BOARD
PT5:	;PLAY ON D+7A
	PUSH	H
;
	;1ST RUN
	LHLD	PITCHA		;ADD PITCH TO WAVEFORM POINTER
	DAD	B
	MOV	B,H
	MOV	C,L
	LDA	WADDRA
	MOV	H,A		;WAVEFORM MSB
	MOV	L,B		;USE INTEGER PART OF POINTER AS INDEX INTO WAVEFORM
	MOV	A,M		;LOAD SAMPLE FROM WAVEFORM
	OUT	D7ACH1		;OUTPUT SAMPLE TO CHANNEL A (ADD 5.5 CLOCKS PER CHANNEL FOR WAIT STATES)
	LHLD	PITCHB		;ADD PITCH TO WAVEFORM POINTER
	DAD	D
	XCHG
	LDA	WADDRB
	MOV	H,A		;WAVEFORM MSB
	MOV	L,D		;USE INTEGER PART OF POINTER AS INDEX INTO WAVEFORM
	MOV	A,M		;LOAD SAMPLE FROM WAVEFORM
	OUT	D7ACH2		;OUTPUT SAMPLE TO CHANNEL B (ADD 5.5 CLOCKS PER CHANNEL FOR WAIT STATES)
;
	;2ND RUN
	LHLD	PITCHA
	DAD	B
	MOV	B,H
	MOV	C,L
	LDA	WADDRA
	MOV	H,A
	MOV	L,B
	MOV	A,M
	OUT	D7ACH1
	LHLD	PITCHB
	DAD	D
	XCHG
	LDA	WADDRB
	MOV	H,A
	MOV	L,D
	MOV	A,M
	OUT	D7ACH2
;
	POP	H		;DECREMENT COUNTER
	DCX	H
	MOV	A,H
	ORA	L
	JNZ	PT5
	RET
;
PTMB:	;PLAY ON MUSIC BOARD
PTMB0:	PUSH	H
;
	;1ST RUN
	LHLD	PITCHA		;ADD PITCH TO WAVEFORM POINTER
	DAD	B
	MOV	B,H
	MOV	C,L
	LDA	WADDRA
	MOV	H,A		;WAVEFORM MSB
	MOV	L,B		;USE INTEGER PART OF POINTER AS INDEX INTO WAVEFORM
	MOV	A,M		;LOAD SAMPLE FROM WAVEFORM
	OUT	MBCH1		;OUTPUT SAMPLE TO CHANNEL A (ADD 5.5 CLOCKS PER CHANNEL FOR WAIT STATES)
	LHLD	PITCHB		;ADD PITCH TO WAVEFORM POINTER
	DAD	D
	XCHG
	LDA	WADDRB
	MOV	H,A		;WAVEFORM MSB
	MOV	L,D		;USE INTEGER PART OF POINTER AS INDEX INTO WAVEFORM
	MOV	A,M		;LOAD SAMPLE FROM WAVEFORM
	OUT	MBCH2		;OUTPUT SAMPLE TO CHANNEL B (ADD 5.5 CLOCKS PER CHANNEL FOR WAIT STATES)
;
	;2ND RUN
	LHLD	PITCHA
	DAD	B
	MOV	B,H
	MOV	C,L
	LDA	WADDRA
	MOV	H,A
	MOV	L,B
	MOV	A,M
	OUT	MBCH1
	LHLD	PITCHB
	DAD	D
	XCHG
	LDA	WADDRB
	MOV	H,A
	MOV	L,D
	MOV	A,M
	OUT	MBCH2
;
	POP	H		;DECREMENT COUNTER
	DCX	H
	MOV	A,H
	ORA	L
	JNZ	PTMB0
	RET
;
;	PNOISE - PLAY WHITE NOISE ON BOTH CHANNELS, 16-BIT DURATION IN DURAT,
;	         VOLUME (0-8) IN VOLUME, 7-BIT PITCH IN PITCHN 
;
;                TODO: SEPARATE VOLUME PER CHANNEL
;
PNOISE:	LDA	VOL1		;CHECK FOR NO SOUND (PLAY REST)
	MOV	B,A
	LDA	VOL2
	ORA	B
	JZ	PNREST
	LDA	PITCHN
	CPI	0
	JZ	PNREST
	MOV	B,A		;CONVERT PITCH INTO PERIOD COUNTER
	MVI	A,127
	SUB	B
	RRC
	RRC
	MOV	B,A		;SAVE A
	LDA	HARDW		;WHICH HARDWARE?
	CPI	3		;SB-1
	JZ	PNOISS
	CPI	0
	JNZ	PN1
	MOV	A,B		;NOISEMAKER
	ANI	01FH
	STA	PITCHC
	JMP	PNOISN
PN1:	LDA	PITCHN
	CPI	0		;REST?
	JZ	PNREST
	LDA	NGEN		;D+7A OR MUSIC BOARD
	CPI	0
	JZ	PNWAVE		;USE NOISE FROM WAVEFORM (PERIODIC NOISE)
	MOV	A,B
	RRC
	ANI	0FH
	STA	PITCHC
	JMP	PNOISW
PNWAVE: ;PERIODIC NOISE AS WAVEFORM ON D+7A (UNMODULATED)
	LDA	WFORMA
	PUSH	PSW
	LDA	WFORMB
	PUSH	PSW
	MVI	A,15
	STA	WFORMA
	STA	WFORMB
	LDA	PITCHN
	STA	PITCHA+1
	STA	PITCHB+1
	MVI	A,0
	STA	PITCHA
	STA	PITCHB
	CALL	PTONEA
	POP	PSW
	STA	WFORMB
	POP	PSW
	STA	WFORMA
	RET
PNREST:	;REST FOR DURATION IN DURAT
	LHLD	DURAT
PNR1:	MVI	A,28		;CALIBRATION
PNR2:	DCR	A
	JNZ	PNR2
	DCX	H
	MOV	A,H
	ORA	L
	JNZ	PNR1
	RET
;
;	PNOISS - PLAY NOISE ON SB-1 WITH 16-BIT DURATION IN DURAT,
;	          VOLUME (0-8) IN VOLUME, PITCH (0-31) IN PITCHC
;
PNOISS:	; TODO (FEED WAVE MEMORY WITH RANDOM DATA, SB-1 LACKS NOISE GENERATOR)
	RET
;
;	PNOISEN - PLAY NOISE ON NOISEMAKER WITH 16-BIT DURATION IN DURAT,
;	          VOLUME (0-8) IN VOLUME, PITCH (0-31) IN PITCHC
;
PNOISN:	;LEFT CHANNEL
	MVI	A,7		;SELECT ENABLE REGISTER
	OUT	NM1REG
	MVI	A,0F7H		;ENABLE LEFT CHANNEL NOISE VOICE A
	OUT	NM1DAT
	MVI	A,8		;SELECT AMPLITUDE REGISTER
	OUT	NM1REG
	LDA	VOL1		;SET AMPLITUDE
	RLC
	OUT	NM1DAT
	MVI	A,6		;SELECT NOISE PERIOD REGISTER
	OUT	NM1REG
	LDA	PITCHN		;SET NOISE PERIOD
	RRC
	RRC
	ANI	01FH
	JNZ	PNN0
	MVI	A,1
PNN0:	MOV	B,A
	MVI	A,32
	SUB	B
	OUT	NM1DAT
	;RIGHT CHANNEL
	MVI	A,7		;SELECT ENABLE REGISTER
	OUT	NM2REG
	MVI	A,0F7H		;ENABLE RIGHT CHANNEL NOISE VOICE A
	OUT	NM2DAT
	MVI	A,8		;SELECT AMPLITUDE REGISTER
	OUT	NM2REG
	LDA	VOL2		;SET AMPLITUDE
	RLC
	OUT	NM2DAT
	MVI	A,6		;SELECT NOISE PERIOD REGISTER
	OUT	NM2REG
	LDA	PITCHN		;SET NOISE PERIOD
	RRC
	RRC
	ANI	01FH
	JNZ	PNN1
	MVI	A,1
PNN1:	MOV	B,A
	MVI	A,32
	SUB	B
	OUT	NM2DAT
	LHLD	DURAT		;IDLE FOR DURATION
PNN2:	MOV	A,H
	ORA	L
	JZ	PNN4
	DCX	H
	MVI	A,25		;CALIBRATION
PNN3:	DCR	A
	JNZ	PNN3
	JMP	PNN2
PNN4:	MVI	A,7		;MUTE LEFT CHANNEL
	OUT	NM1REG
	MVI	A,0FFH
	OUT	NM1DAT
	MVI	A,8
	OUT	NM1REG
	MVI	A,0
	OUT	NM1DAT
	MVI	A,7		;MUTE RIGHT CHANNEL
	OUT	NM2REG
	MVI	A,0FFH
	OUT	NM2DAT
	MVI	A,8
	OUT	NM2REG
	MVI	A,0
	OUT	NM2DAT
	RET
;
;	PNOISW - WHITE NOISE GENERATOR FOR D+7A AND MUISC BOARD, 16-BIT DURATION IN DURAT,
;	         VOLUME (0-7) IN VOLUME, PITCH (0-15) IN PITCHC
;		 192 CPU CLOCKS PER LOOP
;
PNOISW:	LDA	DURAT+1		;DURATION COUNTER IN B/C
	MOV	B,A
	LDA	DURAT
	MOV	C,A
	LDA	VOL1		;TODO: CONTROL VOLUME INDEPENDENTLY FOR BOTH CHANNELS
	MOV	H,A		;INVERT VOLUME (-> 0=HIGHEST VOLUME)
	MVI	A,8
	SUB	H
	MOV	H,A		;INVERTED VOLUME NOW IN H
	MVI	A,07FH
WN0:	DCR	H		;CREATE VOLUME MASK
	JZ	WN1
	ORA	A		;CLEAR CARRY
	RAR
	JMP	WN0
WN1:	STA	VMASK1		;FF FOR VOLUME=8, 7F FOR VOLUME=7, ... 0 FOR VOLUME=0
	LDA	SEED
	MOV	H,A
	LXI	D,0
	LDA	HARDW
	CPI	1
	JNZ	NLOOP1
NLOOP:	CALL	D7NOIS		;OUTPUT RANDOM NOISE ON D+7A
	CALL	D7NOIS		;CALL 2 TIMES FOR BEING IN SYNC WITH TONE GENERATION
	DCX	B
	MOV	A,B
	ORA	C
	JNZ	NLOOP
	RET
NLOOP1:	CALL	MBNOIS		;OUTPUT RANDOM NOISE ON MUISC BOARD
	CALL	MBNOIS		;CALL 2 TIMES FOR BEING IN SYNC WITH TONE GENERATION
	DCX	B
	MOV	A,B
	ORA	C
	JNZ	NLOOP1
	MOV	A,H
	STA	SEED
	RET
;
D7NOIS:	;OUTPUT A RANDOM SAMPLE TO D+7A
	MOV	A,H		;CHECK MSB IN H
	ANA	A
	LDA	VMASK1		;MASK VOLUME
	JM	RND0		;H<0?
	ANA	H
	JMP	RND1
RND0:	CMA			;INVERT MASK
	ORA	H
RND1:	OUT	D7ACH1
	OUT	D7ACH2
	;PSEUDO RANDOM NUMBER GENERATOR
RNDGEN:	LDA	TMP		;DECREMENT PITCH COUNTER
	DCR	A
	JP	RND2
	LDA	PITCHC		;RESET PITCH COUNTER
	STA	TMP
	MOV	A,H		;CREATE PSEUDO RANDOM VALUE
	RRC
	XRA	H
	RRC
	RRC
	XRA	H
	RRC
	XRA	L
	RRC
	RRC
	RRC
	ANI	1
	DAD	H
	MOV	E,A
	DAD	D
	RET
RND2:	STA	TMP		;PAUSE ON CURRENT LEVEL
	MVI	A,8		;ADJUST TO RANDOM GENERATOR
RND3:	DCR	A		;CALIBRATION LOOP
	JNZ	RND3
	RET
;
MBNOIS:	;OUTPUT A RANDOM SAMPLE TO MUSIC BOARD
	MOV	A,H		;CHECK MSB IN H
	ANA	A
	LDA	VMASK1		;MASK VOLUME
	JM	RND4		;H<0?
	ANA	H
	JMP	RND5
RND4:	CMA			;INVERT MASK
	ORA	H
RND5:	ADI	128
	OUT	MBCH1
	OUT	MBCH2
	JMP	RNDGEN
;
;	PSAMPL - PLAY 8-BIT SAMPLES ON D+7A AT ADDRESS D/E WITH SAMPLE COUNT IN B/C, SPEED IN H
;
PSAMPL:	MOV	A,B		;RETURN IF SAMPLE COUNT IS 0
	ORA	C
	RZ
	LDAX	D		;GET 1ST BYTE FOR LEFT CHANNEL
	OUT	D7ACH1
	INX	D
	LDAX	D		;GET 2ND BYTE FOR RIGHT CHANNEL
	OUT	D7ACH1
	INX	D
	DCX	B
	MOV	A,H		;WAIT SOME TIME BEFORE THE NEXT SAMPLE
PSL:	DCR	A
	JNZ	PSL
	JMP	PSAMPL
;
;	PAUDIO - PAUSE AUDIO ON D7A WITH DURATION IN A (WITHOUT PLAYING SAMPLES)
;
PAUDIO:	MOV	B,A
	MVI	A,0		;PAUSE AUDIO FOR A SHORT WHILE
	OUT	D7ACH1
	OUT	D7ACH2
	MVI	C,8
PA1:	DCR	A
	JNZ	PA1
	DCR	C
	JNZ	PA1
	MVI	C,8
	DCR	B
	JP	PA1
	RET
;
;    --- SETUP ROUTINES ---
;
;	SPITCH - SET PITCH TABLES MATCHING SOUND HARDWARE AND CPU CLOCK
;
SPITCH:	MVI	H,0
	LXI	D,PITCHT
	LDA	HARDW
	CPI	0
	JNZ	SP0
	LXI	B,PTAY		;USE PITCH TABLE FOR AY-3-8910 
	JMP	SP3
SP0:	CPI	3
	JNZ	SP1
	LXI	B,PTSB1		;USE PITCH TABLE FOR SB-1
	JMP	SP3
SP1:	LDA	SYSCLK
	CPI	2
	JNZ	SP2
	LXI	B,PT100		;USE 2 MHZ PITCH TABLE FOR DAC
	JMP	SP3
SP2:	LXI	B,PT200		;USE 4 MHZ PITCH TABLE FOR DAC
SP3:	LDAX	B
	STAX	D
	INX	B
	INX	D
	DCR	H
	JNZ	SP3
	RET
;
;	SMETRO - SET METRONOME/TEMPO IN BEATS PER MINUTE
;
;	REMARK: TEMPI < 95 BPM MAY NOT FIT ANY MORE INTO 16-BIT LOOP COUNTS
;               FOR LONG NOTES ON FAST 6 MHZ CPUS
;
;	TONE DURATIONS FOR 120 BPM WITH RESPECT TO 62 HZ DAZZLER FIELD FREQUENCY:
;
;	 1 FULL NOTE WITH DOT		192 VIDEO FIELDS
;	 2 FULL NOTE 			128 VIDEO FIELDS
;	 3 HALF NOTE WITH DOT 		 96 VIDEO FIELDS
;	 4 HALF NOTE 			 64 VIDEO FIELDS
;	 5 QUARTER NOTE WITH DOT	 48 VIDEO FIELDS
;	 6 QUARTER NOTE			 32 VIDEO FIELDS
;	 7 EIGHTH NOTE WIDTH DOT	 24 VIDEO FIELDS
;        8 1/3 HALF NOTE                 21 VIDEO FIELDS
;	 9 EIGHTH NOTE			 16 VIDEO FIELDS
;	10 SIXTEENTH NOTE WITH DOT 	 12 VIDEO FIELDS
;	11 1/3 QUARTER NOTE              11 VIDEO FIELDS
;	12 SIXTEENTH NOTE		  8 VIDEO FIELDS
;	13 THIRTY-SECOND NOTE WITH DOT	  6 VIDEO FIELDS
;	14 THIRTY-SECOND NOTE		  4 VIDEO FIELDS
;	15 1/3 EIGTH NOTE                 3 VIDEO FIELDS
;
;	DURATION (LOOP COUNT) OF QUARTER NOTE = 
;		= (SYSCLK * 1,000,000) * (60 / BPM) / CLOCKCYCLES
;		= 178,042 * SYSCLK / BPM (FOR 337 CLOCKCYCLES)
;
;      = 17804 / BPM * 10 * SYSCLK
;
SMETRO:	;CREATE DURATION TABLES FOR 2MHZ, 4MHZ AND 6MHZ CPU CLOCKS (DEPENDING ON METRO AND SYSCLK)
	;STEP 1: CALCULATE LOOP COUNT FOR QUARTER NOTE
	LXI	B,17804		;DIVIDE 17804 BY BPM
	MVI	H,0
	LDA	METRO
	MOV	L,A
	CALL	DIV16		;NOW QUOTIENT IS IN HL WITH REMAINDER IN DE
	XCHG			;MOVE QUOTIENT TO DE
	LXI	H,0		;TIMES 10
	MVI	A,10
MET0:	DAD	D
	DCR	A
	JNZ	MET0
	XCHG
	LXI	H,0		;TIMES SYSCLK
	LDA	SYSCLK
MET1::	DAD	D
	DCR	A
	JNZ	MET1
	;STEP 2: CREATE DURATION TABLE
	SHLD	DURATT+12	;QUARTER NOTE
	CALL	MULT2
	SHLD	DURATT+8	;HALF NOTE
	CALL	MULT2
	SHLD	DURATT+4	;FULL NOTE
	LHLD	DURATT+12	;EIGTH NOTE
	CALL	DIV2
	SHLD	DURATT+18
	CALL	DIV2		;SIXTEENTH NOTE
	SHLD	DURATT+24
	CALL	DIV2		;THIRTY-SECOND NOTE
	SHLD	DURATT+30
	LHLD	DURATT+4	;FULL NOTE WITH DOT
	XCHG
	LHLD	DURATT+8
	DAD	D
	SHLD	DURATT+2
	LHLD	DURATT+8	;HALF NOTE WITH DOT
	XCHG
	LHLD	DURATT+12
	DAD	D
	SHLD	DURATT+6	
	LHLD	DURATT+12	;QUARTER NOTE WITH DOT
	XCHG
	LHLD	DURATT+18
	DAD	D
	SHLD	DURATT+10	
	LHLD	DURATT+18	;EIGTH NOTE WITH DOT
	XCHG
	LHLD	DURATT+24
	DAD	D
	SHLD	DURATT+14	
	LHLD	DURATT+24	;SIXTEENTH NOTE WITH DOT
	XCHG
	LHLD	DURATT+28
	DAD	D
	SHLD	DURATT+20	
	LHLD	DURATT+28	;THIRTY-SECOND NOTE WITH DOT
	CALL	DIV2
	XCHG
	LHLD	DURATT+28
	DAD	D
	SHLD	DURATT+26
	LHLD	DURATT+8	;1/3 HALF NOTE
	MOV	B,H
	MOV	C,L	
	LXI	H,3
	CALL	DIV16
	SHLD	DURATT+16
	LHLD	DURATT+12	;1/3 QUARTER NOTE
	MOV	B,H
	MOV	C,L	
	LXI	H,3
	CALL	DIV16
	SHLD	DURATT+22
	LHLD	DURATT+18	;1/3 EIGTH NOTE
	MOV	B,H
	MOV	C,L	
	LXI	H,3
	CALL	DIV16
	SHLD	DURATT+28
	LXI	H,0		;RESERVED
	SHLD	DURATT
	RET
;
MKWAVT:	; SETUP WAVETABLES FOR D+7A & MUSICBOARD
	;COPY MASTER WAVEFORM WITH 7 DIFFERENT LEVELS INTO WAVE TABLE
	LXI	B,SIN256
	LXI	D,WAVET
	DCR	D		;D/E NOW POINTING TO MASTER TABLE
	;PROCESS ALL 256 SAMPLES IN A WAVEFORM
WTAB1:	MVI	A,7
	ADD	D
	MOV	D,A		;D/E NOW POINTING TO LAST WAVEFORM IN WAVETABLE
	MVI	H,7		;USE H AS COUNTER OVER THE WAVEFORMS
	LDA	HARDW
	CPI	1
	JNZ	WTAB3
	;D+7A
	LDAX	B		;GET SAMPLE FROM MASTER TABLE
WTAB2:	STAX	D		;COPY SAMPLE WITH PROPER ATTENUATION INTO ALL 7 WAVE TABLES
	ORA	A		;CLEAR CARRY
	PUSH	B
	CALL	SDIV2		;DIVIDE LEVEL BY 2
	POP	B
	DCR	D
	DCR	H
	JNZ	WTAB2
	INR	C		;NEXT SAMPLE (MASTER TABLE)
	INR	E		;NEXT SAMPLE (WAVE TABLE)
	JNZ	WTAB1
	RET
WTAB3:	;MUSIC BOARD
	LDAX	B
	STA	TMP
	ADI	128
WTAB4:	STAX	D		;COPY SAMPLE WITH PROPER ATTENUATION INTO ALL 7 WAVE TABLES
	ORA	A		;CLEAR CARRY
	PUSH	B
	LDA	TMP
	CALL	SDIV2		;DIVIDE LEVEL BY 2
	STA	TMP
	ADI	128
	POP	B
	DCR	D
	DCR	H
	JNZ	WTAB4
	INR	C		;NEXT SAMPLE (MASTER TABLE)
	INR	E		;NEXT SAMPLE (WAVE TABLE)
	JNZ	WTAB1
	RET

;
;	--- HELPER ROUTINES ---
;
;	CINPUT - INPUTS A NULL TERMINATED STRING FROM CONSOLE INTO
;		 MEMORY POINTED TO BY BUFFER, MAX STRING LENGTH IN A
;		 RETURNS ACTUAL STRING LENGTH IN A, D/E POINTING TO THE START OF THE STRING
;
CINPUT:	STA	BUFFER		;LIMIT USER INPUT
	LXI	D,BUFFER	;GET USER INPUT FROM CONSOLE
	MVI	C,READSTR
	CALL	BDOS
	LXI	D,BUFFER+2	;SET INDEX POINTER TO START OF RETURN STRING
	MVI	H,0		;TERMINATE STRING WITH NULL
	LDA	BUFFER+1
	MOV	L,A
	DAD	D
	MVI	M,0
	RET
;
;	GETNUM - TAKES A STRING WITH ADDRESS IN D/E, MAX NUM DIGITS IN B,
;                RETURNS A 16-BIT NUMBER IN H/L, SETS CARRY IN CASE OF ERROR
;                INPUT STRING SHOULD BE NULL TERMINATED
;
GETNUM:	LDAX	D		;FIRST DIGIT
	INX	D		;NEXT CHARACTER IN BUFFER
	CPI	' '		;SKIP LEADING BLANKS
	JZ	GETNUM
	MVI	H,0		;CLEAR HL
	MVI	L,0
	CALL	HEXINT		;CONVERT DIGIT TO INTEGER
	RC			;RETURN WITH CARRY SET IF NO DIGIT
GN2:	PUSH	PSW		;SAVE RESULT
	MVI	C,4		;SHIFT HL LEFT 4X
GN3:	MOV	A,L
	ORA	A		;CLEAR CARRY
	RAL
	MOV	L,A
	MOV	A,H
	RAL
	MOV	H,A
	DCR	C
	JNZ	GN3
	POP	PSW		;RESTORE RESULT
	ORA	L		;STORE RESULT IN L
	MOV	L,A
	DCR	B
	JZ	GN4
	LDAX	D
	INX	D
	CALL	HEXINT
	JNC	GN2
GN4:	ORA	A		;DONE, CLEAR CARRY, RESULT IN HL
	RET
;
HEXINT:	;CONVERT HEX DIGIT TO INT,RETURN RESULT IN A,SETS CARRY IN CASE OF ERROR
	CPI	'0'
	JM	HERR
	CPI	':'
	JP	HLET
	SUI	30H
	JMP	HOK
HLET:	ANI	0DFH	;TO UPPER CASE
	CPI	'A'
	JM	HERR
	CPI	'G'
	JP	HERR
	SUI	37H
HOK:	ORA	A	;CLEAR CARRY FOR OK
	RET
HERR:	STC		;SET CARRY FOR ERROR
	RET
;
;    --- FILE UTILS ---
;
GETFN:	;PROMPT FOR FILENAME AND SET UP FCB
	LXI	D,SELFN		;PROMPT FOR FILENAME
	MVI	C,PRINTF
	CALL	BDOS
	MVI	A,12		;INPUT FILENAME
	STA	BUFFER
	LXI	D,BUFFER
	MVI	C,READSTR
	CALL	BDOS
	;PREPARE FCB
	MVI	A,' '		;BLANK FILENAME + FILE TYPE
	MVI	H,11
	LXI	B,FCBFN
BLANK:	STAX	B
	INX	B
	DCR	H
	JNZ	BLANK
	MVI	A,0
	STA	FCBDN		;DISK NAME
	STA	FCBRL		;REEL NUMBER/EXTENT
	STA	FCBRC		;RECORD COUNT
	;COPY FILENAME AND FILE TYPE
	LDA	BUFFER+1	;COPY FILENAME
	CPI	0
	RZ
	MOV	H,A
	LXI	B,BUFFER+2
	LXI	D,FCBFN
FN:	LDAX	B
	CPI	'.'
	JNZ	NODOT
	LXI	D,FCBFT		;SWITCH TO FILE TYPE
	JMP	LBL13
NODOT:	ANI	0DFH		;UPPERCASE
	STAX	D
	INX	D
LBL13:	INX	B
	DCR	H
	JNZ	FN
	RET
;
FOPEN:	CALL	GETFN		;GET FILENAME
	XRA	A		;CLEAR CURRENT RECORD
	STA	FCBCR
	LDA	DAZZLR		;DISABLE DAZZLER DURING FLOPPY ACCESS
	CPI	0
	JZ	FOP1
	MVI	A,0
	OUT	DAZFLG
FOP1:	LXI	D,FCB		;OPEN FILE
	MVI	C,OPENF
	CALL	BDOS
	CPI	0FFH		;ERROR?
	STC
	RNZ			;RETURN ON OK
	LXI	D,FNFMSG	;FILE NOT FOUND, OUTPUT ERROR MESSAGE AND RETURN
	MVI	C,PRINTF
	CALL	BDOS
	ORA	A		;CLEAR CARRY FOR ERROR CONDITION
	RET
;
FCLOSE:	;CLOSE FILE
	LXI	D,FCB
	MVI	C,CLOSEF
	CALL	BDOS
;	LDA	DAZZLR		;RE-ENABLE DAZZLER
;	CPI	0
;	RZ
;	MVI	A,080H
;	OUT	DAZFLG
	RET
;
FREAD:	;READ A FILE DEFINED IN FCB INTO RAM AT ADDRESS D/E
	MVI	A,80H
	STA	IBP		;SET READ BUFFER POINTER TO 80H
FR1:	PUSH	H
	CALL	GNB		;READ NEXT DATA BYTE INTO SAMPLE BUFFER
	POP	H
	RC			;RETURN ON EOF
	XCHG
	STAX	D
	XCHG
	INX	H
	JMP	FR1		;LOOP UNTIL EOF
;
FERROR:	POP	B
	POP	D
	PUSH	PSW
	LXI	D,ERRMSG
	MVI	C,PRINTF
	CALL	BDOS
	POP	PSW
	CALL	PHEX
	CALL	CRLF
	JMP	MENU
;
GNB:	;GET NEXT BYTE
	LDA	IBP
	CPI	80H
	JNZ	G0
	;READ ANOTHER BUFFER
	CALL	DISKR
	ORA	A		;ZERO VALUE IF READ OK
	JZ	G0		;FOR ANOTHER BYTE
	;END OF DATA, RETURN WITH CARRY SET FOR EOF
	STC
	RET
;
G0:	;READ THE BYTE AT BUFF+REG A
	MOV	E,A		;LS BYTE OF BUFFER INDEX
	MVI	D,0		;DOUBLE PRECISION INDEX TO DE
	INR	A		;INDEX=INDEX+1
	STA	IBP		;BACK TO MEMORY
	;POINTER IS INCREMENTED
	;SAVE THE CURRENT FILE ADDRESS
	LXI	H,BUFF
	DAD	D
	;ABSOLUTE CHARACTER ADDRESS IS IN HL
	MOV	A,M
	;BYTE IS IN THE ACCUMULATOR
	ORA	A		;RESET CARRY BIT (EOF NOT REACHED)
	RET
;
;
DISKR:	;READ DISK FILE RECORD
	PUSH H
	PUSH D
	PUSH B
	MVI	A,'.'
	CALL	PCHAR
	LXI	D,FCB
	MVI	C,READF
	CALL	BDOS
	POP B
	POP D
	POP H
	RET
;
WNB:	;WRITE NEXT BYTE
	PUSH	PSW	;SAVE A
	LDA	IBP
	CPI	80H
	JNZ	W0
	;WRITE ANOTHER BUFFER
	CALL	DISKW
	ORA	A		;ZERO VALUE IF READ OK
	JZ	W0		;FOR ANOTHER BYTE
	;WRITE ERROR
	POP	PSW
	STC
	RET
;
W0:	;WRITE THE BYTE AT BUFF+REG A
	MOV	E,A		;LS BYTE OF BUFFER INDEX
	MVI	D,0		;DOUBLE PRECISION INDEX TO DE
	INR	A		;INDEX=INDEX+1
	STA	IBP		;BACK TO MEMORY
	;POINTER IS INCREMENTED
	;SAVE THE CURRENT FILE ADDRESS
	LXI	H,BUFF
	DAD	D
	;ABSOLUTE CHARACTER ADDRESS IS IN HL
	POP	PSW
	MOV	M,A
	ORA	A		;RESET CARRY BIT
	RET
;
;
DISKW:	;WRITE DISK FILE RECORD
	PUSH H
	PUSH D
	PUSH B
	MVI	A,'.'
	CALL	PCHAR
	LXI	D,FCB
	MVI	C,WRITEF
	CALL	BDOS
	POP B
	POP D
	POP H
	RET
;
;
PCHAR:	;PRINT A CHARACTER
	MVI	C,TYPEF
	MOV	E,A
	CALL	BDOS
	RET
;
CRLF:
	MVI	A,CR
	CALL	PCHAR
	MVI	A,LF
	CALL	PCHAR
	RET
;
;
PNIB:	;PRINT NIBBLE IN REG A
	ANI	0FH	;LOW 4 BITS
	CPI	10
	JNC	P10
	;LESS THAN OR EQUAL TO 9
	ADI	'0'
	JMP	PRN
;
	;GREATER OR EQUAL TO 10
P10:	ADI	'A' - 10
PRN:	CALL	PCHAR
	RET
;
PHEX:	;PRINT HEX CHAR IN REG A
	PUSH	PSW
	RRC
	RRC
	RRC
	RRC
	CALL	PNIB		;PRINT NIBBLE
	POP	PSW
	CALL	PNIB
	RET
;
BREAK:	;BREAK ON KEY
	PUSH H
	PUSH D
	PUSH B; ENVIRONMENT SAVED
	MVI	C,BRKF
	CALL	BDOS
	POP B
	POP D
	POP H; ENVIRONMENT RESTORED
	RET
;
;
;	PSEUDO RANDOM NUMBER GENERATOR (RETURNS RANDOM NUMBER IN A) DOES NOT CHANGE B/C AND H/L
RND:	LDA	PX	;
	MOV	D,A
	RLC
	RLC
	RLC
	RLC
	ANI	0F0H
	XRA	D
	MOV	D,A		; T = X^(X<<4)
	LDA	PY		; X=Y
	STA	PX
	LDA	PZ		; Y=Z
	STA	PY
	LDA	SEED		; Z=A
	STA	PZ
	XRA	D
	MOV	E,A		; Z^T
	LDA	PZ
	RRC
	ANI	07FH
	XRA	E
	MOV	E,A		; Z^T^(Z>>1)
	MOV	A,D
	RLC
	ANI	0FEH
	XRA	E		; Z^T^(Z>>1)^(T<<1)
	STA	SEED
	RET
SEED:	DS	1
PX	DS	1
PY	DS	1
PZ	DS	1
;
;	SDIV2 - DIVIDE SIGNED 8-BIT VALUE IN A BY TWO
;
SDIV2:  ORA A
	JP ASHIFT		;A >= 0?
	MOV B,A
	ANI 01H			;ODD/EVEN?
	JNZ CORR
	MOV A,B
	JMP ASHIFT
CORR:	MOV A,B			;INCREMENT IF A<0 AND ODD
	INR A
ASHIFT:	MOV B,A			;ARITHMETIC SHIFT RIGHT
	RLC
	MOV A,B
	RAR
	RET			; RESULT IS NOW IN A    
;
;	MULT2 - MULTIPLY UNSIGNED 16-BIT VALUE in H/L BY TWO
;
MULT2:	ORA	A
	MOV	A,L
	RAL
	MOV	L,A
	MOV	A,H
	RAL
	MOV	H,A
	RET
;
;	DIV2 - DIVIDE UNSIGNED 16-BIT VALUE IN H/L BY TWO
;
DIV2:	ORA	A		;CLEAR CARRY
	MOV	A,H
	RAR
	MOV	H,A
	MOV	A,L
	RAR
	MOV	L,A
	RET
;
;
; DIV16 - 16-BIT UNSIGNED DIVISION USING A BIT-BY-BIT SHIFT-AND-SUBTRACT ALGORITHM.
;
;         DIVIDENT IN BC, DIVISOR IN HL, RETURNS QUOTIENT IN HL AND REMAINDER IN DE
;	  CARRY SET ON RETURN IN CASE OF DIVISION BY ZERO
;
	;TEST FOR DIVISION BY ZERO
DIV16:	MOV	A,H
	ORA	L
	STC
	RZ
	;PEPARE FOR REVERSE POLARITY SUBTRACTION
	MOV	A,B
	CMA
	MOV	D,A
	MOV	A,C
	CMA
	MOV	E,A
	INX	B
        XRA	A
	STA	QUOT
	STA	QUOT+1
	JMP	DIV_1
	;FIRST PHASE: DOUBLING THE DIVISOR
DIV_0:	DAD	B
DIV_1:	INR	A
        PUSH	H
        DAD	H
        JC	DIV_2
	DAD	D
	JNC	DIV_0
	;SECOND PHASE: SUBTRACTING FROM THE DIVIDEND AND ACCUMULATING QUOTIENT BITS
DIV_2:	MOV	B,A
DIV_3:	POP	H
	DAD	D
	JC	DIV_4
	XCHG
DIV_4:	CMC
	LDA	QUOT
	RAL
	STA	QUOT
	LDA	QUOT+1
	RAL
	STA	QUOT+1
	DCR	B
	JNZ	DIV_3
	LHLD	QUOT
	MOV	A,E
	CMA
	MOV	E,A
	MOV	A,D
	CMA
	MOV	D,A
	RET
QUOT:	DS	2		;BUFFER FOR EVOLVING QUOTIENT
;
; DETECT - TRY TO DETERMINE CPU CLOCK VIA DAZZLER
; IF DAZZLER PRESENT, STORE 1 to DAZZLER AND SYSTEM CLOCK IN SYSCLK
; CARRY CLEARED ON SUCCESS, CARRY SET IN CASE OF TIMEOUT
DETECT:	MVI	A,080H		;ENABLE DAZZLER
	OUT	DAZFLG
	;WAIT FOR FRAME
	LXI	B,02000H	;TIMEOUT VALUE
AD1:	DCX	B
	MOV	A,B
	ORA	C
	JZ	TIMOUT		;BREAK ON TIMEOUT
	IN	DAZFLG
	ANI	040H
	JZ	AD1
	;WAIT FOR END OF FRAME
	LXI	B,0B000H	;TIMEOUT VALUE
AD2:	DCX	B
	MOV	A,B
	ORA	C
	JZ	TIMOUT		;BREAK ON TIMEOUT
	IN	DAZFLG
	ANI	040H
	JNZ	AD2
	;WAIT FOR END OF VERTICAL BLANK (4 MS)
	LXI	B,0A0H		;TIMEOUT VALUE
	LXI	D,0
AD3:	MVI	A,08H		;LATENCY LOOP
AD4:	DCR	A
	JNZ	AD4
	INX	D		;LOOP COUNT
	DCX	B
	MOV	A,B
	ORA	C
	JZ	TIMOUT		;BREAK ON TIMEOUT
	IN	DAZFLG
	ANI	040H
	JZ	AD3
	MVI	A,1		;YES WE HAVE DAZZLER!
	STA	DAZZLR
	;AUTODETECT CPU CLOCK FROM B/C 2MHZ=46, 4MH=90, 6MHZ=136
	MOV	A,E
	CPI	69
	JNC	AD5
	MVI	A,2		;2 MHZ
	JMP	RETOK
AD5:	CPI	113
	JNC	AD6
	MVI	A,4		;4 MHZ
	JMP	RETOK
AD6:	MVI	A,6		;6 MHZ
RETOK:	STA	SYSCLK
	ORA	A		;CLEAR CARRY FOR SUCCESS
	MVI	A,0		;DISABLE DAZZLER
	OUT	DAZFLG
	RET
TIMOUT:	STC			;SET CARRY FOR TIMEOUT
	MVI	A,0		;DISABLE DAZZLER
	OUT	DAZFLG
	RET
;
;    --- STRINGS ---
;
SIGNON:	DB	CR,LF,LF,'S100 AUDIO TEST UTILITY VERSION 1.0',CR,LF,'$'
CLKMSG:	DB	CR,LF,'PLEASE ENTER CPU CLOCK SPEED IN MHZ: $'
USAGE1:	DB	CR,LF,'SELECT ONE OF:',CR,LF,LF,'H SELECT HARDWARE$'
USAGE2:	DB	CR,LF,'T PLAY TONE',CR,LF,'N PLAY NOISE$'
USAGE3:	DB	CR,LF,'F PLAY SAMPLE FILE',CR,LF,'S PLAY SCORE FILE',CR,LF,'W LOAD WAVE TABLE FILE$'
USAGE4:	DB	CR,LF,'A AUDIO TEST',CR,LF,'J JOYSTICK TEST',CR,LF,'Q QUIT',CR,LF,'$'
HWMSG: 	DB	CR,LF,'SELECT ONE OF:',CR,LF,'$'
NOISEM: DB	CR,LF,'0 ADS NOISEMAKER (AY-3-8910)$'
D7A:    DB	CR,LF,'1 CROMEMCO D+7A (D/A CONVERTER)$'
MB:	DB	CR,LF,'2 NEWTECH MUSIC BOARD (D/A CONVERTER)$'
SB1:	DB	CR,LF,'3 SOLID STATE MUSIC SB-1 (SYNTHESIZER)',CR,LF,LF,'$'
NMKMSG:	DB	CR,LF,'-> CURRENT HARDWARE IS NOISEMAKER AT I/O BASE $'
D7AMSG:	DB	CR,LF,'-> CURRENT HARDWARE IS D+7A AT I/O BASE $'
MBMSG:	DB	CR,LF,'-> CURRENT HARDWARE IS MUSIC BOARD AT I/O BASE $'
SB1MSG:	DB	CR,LF,'-> CURRENT HARDWARE IS SOLID STATE MUSIC SB-1 AT MEMORY $'
SELFN:	DB	CR,LF,'FILENAME: $'
FNFMSG:	DB	CR,LF,'FILE NOT FOUND$'
PITMSG:	DB	CR,LF,'PITCH (HEX 0-FFFF): $'
PI2MSG:	DB	CR,LF,'PITCH (HEX 0-FFF): $'
PINMSG:	DB	CR,LF,'PITCH (HEX 0-7F): $'
VOLMSG:	DB	CR,LF,'VOLUME (0-7): $'
DURMSG:	DB	CR,LF,'DURATION (HEX 0-FF): $'
SPDMSG:	DB	CR,LF,'SPEED: $'
ERRMSG:	DB	CR,LF,'ERROR$'
TMSG1:	DB	CR,LF,'PART I: SLIDING TONES (LEFT/RIGHT TEST)',CR,LF,'$'
TMSG2:	DB	CR,LF,'PART II: STEREO POSITIONING TEST',CR,LF,'$'
TMSG3:	DB	CR,LF,'PART III: WHITE NOISE TEST',CR,LF,'$'
TMSG4:	DB	CR,LF,'Yes, I',39,'d like to hear it, HAL. Sing it for me....',CR,LF,'$'
FNDMSG:	DB	CR,LF,'DAZZLER HARDWARE FOUND WITH CPU CLOCK $'
NONOIS:	DB	CR,LF,'HARDWARE LACKS NOISE GENERATOR',CR,LF,'$'
MHZMSG:	DB	' MHZ$'
;
;    --- VARIABLES ---
IBP:	DS	2	;DISK BUFFER POINTER
OLDSP:	DS	2	;ENTRY SP VALUE FROM CCP
BUFFER:	DS	16	;LINE BUFFER
SYSCLK:	DS	1	;SYSTEM CLOCK IN MHZ
METRO:	DS	1	;MUSIC SPEED IN BEATS PER MINUTE
NPLAYR:	DS	1
PITCHA:	DS	2	;AUDIO PITCH VOICE 0
PITCHB:	DS	2	;AUDIO PITCH VOICE 1
PITCHN:	DS	1	;NOISE PITCH
PITCHC:	DS	1	;NOISE PITCH COUNTER
WFORMA:	DS	1	;CURRENT WAVEFORM VOICE 0
WFORMB:	DS	1	;CURRENT WAVEFORM VOICE 1
WADDRA:	DS	1	;MSB OF CURRENT WAVEFORM IN WAVETABLE VOICE 0
WADDRB:	DS	1	;MSB OF CURRENT WAVEFORM IN WAVETABLE VOICE 1
DURAT:	DS	2	;DURATION OF AUDIO EVENT (CPU SPEED DEPENDENT)
LEGATO:	DS	1	;LEGATO FLAG, BIT X = CHANNEL X (1=LEGATO ENABLED)
VMASK1:	DS	1	;VOLUME MASK FOR NOISE CHANNEL 1
VMASK2:	DS	1	;VOLUME MASK FOR NOISE CHANNEL 2
TMP:	DS	2	;TEMPORARY
VOL1:	DS	1	;AUDIO VOLUME CHANNEL 1
VOL2:	DS	1	;AUDIO VOLUME CHANNEL 2
ENVEL:	DS	1	;ENVELOPE
SPEED:	DS	1	;SPEED FOR SAMPLE PLAYBACK
HARDW:	DS	1	;CURRENT AUDIO HARDWARE 0=ADS NOISEMAKER, 1=CROMEMCO D+7A, 2=NEWTECH MUSIC BOARD 3=SSM SB-1
LASTVS:	DS	1	;LAST VSYNC
DAZZLR: DS	1	;0=NO DAZZLER, 1=DAZZLER PRESENT
NGEN:	DS	1	;0=USE WAVEFORM 15 FOR NOISE, 1=USE WHITE NOISE GENERATOR
ACCENT:	DS	1	;REST DURATION FOR ACCENT
NMODE:	DS	1	;SWITCH FOR TONE VS. NOISE FOR 8 VOICES (LSB = VOICE 0)
SB1CTL:	DS	1	;CONTROL BYTE FIRST SB-1 BOARD
SB2CTL:	DS	1	;CONTROL BYTE SECOND SB-1 BOARD
;
;
;    ---- TABLES ----
;
;	SCORE TABLE - ACTUAL MUSIC SCORE
;
SCORE:	
	;Daisy Bell
        DB      060H,0A0H	
        DB      013H,04AH,04AH
        DB      013H,047H,047H
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        DB      000H
;
ENV16:
;	CONSTANT AMPLITUDE ENVELOPE FOR SB-1
	DB	0CH,0CH,0CH,0CH,0CH,0CH,0CH,0CH,0CH,0CH,0CH,0CH,0CH,0CH,0CH,0CH
;
SIN32:
	DB	09AH,0B1H,0C7H,0DAH,0EAH,0F5H,0FEH,0FFH,0FEH,0F5H,0EAH,0DAH,0C7H,0B1H,09AH,080H
	DB	067H,04FH,039H,026H,016H,00BH,002H,001H,002H,00BH,016H,026H,039H,04FH,067H,080H
;
ALIGN:
	DS	256 - (ALIGN MOD 256)	; 256 BYTE ALIGNMENT
;
;	SINUS TABLE - 256 SIGNED 8-BIT SAMPLES FOR ONE FULL SINUS CYCLE
;
SIN256:
	DB	000H,003H,006H,009H,00CH,00FH,012H,015H,018H,01CH,01FH,022H,025H,028H,02BH,02EH
	DB	030H,033H,036H,039H,03CH,03FH,041H,044H,047H,049H,04CH,04EH,051H,053H,055H,058H
	DB	05AH,05CH,05EH,060H,062H,064H,066H,068H,06AH,06CH,06DH,06FH,070H,072H,073H,075H
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	DB	0D0H,0D2H,0D5H,0D8H,0DBH,0DEH,0E1H,0E4H,0E8H,0EBH,0EEH,0F1H,0F4H,0F7H,0FAH,0FDH
;
;	WAVE TABLE (ROOM FOR UP TO 16 CUSTOM WAVEFORMS), ALSO USED TO IMPLEMENT VOLUME CONTROL
;	FOR BOARDS WHICH LACK PROGRAMMABLE AMPLITUDE
;
WAVET:	DS	4096
;
;	DAC PITCH TABLE - PITCH VALUES FOR 128 MIDI STANDARD TONES
;
;	PITCH = 65536 * FREQUENCY / SAMPLING RATE
;
;	PITCH 0 DENOTES REST (NO TONE)
;
;	EFFECTIVE ARE ONLY 0000-07FFF BECAUSE OF USING 256 SAMPLES PER WAVEFORM
;
;	MOST COMMON TONES:
;	OCTAVE 3: C3=30, C#3/DB3=31, D3=32, D#3/EB3=33, E3=34, F3=35, F#3/GB3=36, G3=37, G#3/AB3=38, A3=39, A#3/BB3=3A, B3=3B
;	OCTAVE 4: C4=3C, C#4/DB4=3D, D4=3E, D#4/EB4=3F, E4=40, F4=41, F#4/GB4=42, G4=43, G#4/AB4=44, A4=45, A#4/BB4=46, B4=47
;	OCTAVE 5: C5=48, C#5/DB5=49, D5=4A, D#5/EB5=4B, E5=4C, F5=4D, F#5/GB5=4E, G5=4F, G#5/AB5=50, A5=51, A#5/BB5=52, B5=53
;	OCTAVE 6: C6=54, C#6/DB6=55, D6=56, D#6/EB6=57, E6=58, F6=59, F#6/GB6=5A, G6=5B, G#6/AB6=5C, A6=5D, A#6/BB6=5E, B6=5F
;
PITCHT:	DS	256
;
PT100:	;DAC 10.0 KHZ
	DW	00000H,00038H,0003CH,0003FH,00043H,00047H,0004BH,00050H
	DW	00055H,0005AH,0005FH,00065H,0006BH,00071H,00078H,0007FH
	DW	00087H,0008FH,00097H,000A0H,000AAH,000B4H,000BEH,000CAH
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	DW	0FFFFH,0D652H,0E311H,0F091H,0FEE0H,0FFFFH,0FFFFH,0FFFFH
;
PT200:	;DAC 20.0 KHZ
	DW	00000H,0001CH,0001EH,0001FH,00021H,00023H,00025H,00028H
	DW	0002AH,0002DH,0002FH,00032H,00035H,00038H,0003CH,0003FH
	DW	00043H,00047H,0004BH,00050H,00055H,0005AH,0005FH,00065H
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	DW	06B29H,07188H,07848H,07F70H,08703H,08F0BH,0978CH,0A08FH
;
; NOISEMAKER (AY-3-8910) PITCH TABLE
;
; DIVIDER = 2 MHZ / 16 / FREQUENCY
; MSB = DIVIDER / 256
; LSB = DIVIDER % 256
;
PTAY	;
	DW	00000H,0385EH,03534H,03238H,02F66H,02CBDH,02A3AH,027DCH
	DW	0259FH,02382H,02184H,01FA3H,01DDCH,01C2FH,01A9AH,0191CH
	DW	017B3H,0165EH,0151DH,013EEH,012CFH,011C1H,010C2H,00FD1H
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	DW	0000EH,0000EH,0000DH,0000CH,0000BH,0000BH,0000AH,00009H
;
; SSM SB-1 PITCH TABLE
;
; MSB = OCTAVE, LSB = PITCH WITHIN OCTAVE
;
; LSB = 256 - (20,000,000 / (32 * FREQUENCY * (1 << (8 - OCTAVE))))
;
PTSB1	;
	DW	00000H,00000H,00000H,00000H,00000H,00000H,00000H,00000H
	DW	00000H,00000H,00000H,00000H,0006BH,00074H,0007BH,00083H
	DW	0008AH,00091H,00097H,0009DH,000A2H,000A8H,000ADH,000B1H
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	DW	00000H,00000H,00000H,00000H,00000H,00000H,00000H,00000H
;
;	DURATION TABLE FOR NOTES
;
DURATT:	DS	32
;
;
;    --- STACK AREA ---
	DS	64	;RESERVE 32 LEVEL STACK
STKTOP:

	END
